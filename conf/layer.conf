## conf/layer.conf
```bitbake
# We have a conf and classes directory, add to BBPATH
BBPATH .= ":${LAYERDIR}"

# We have recipes-* directories, add to BBFILES
BBFILES += "${LAYERDIR}/recipes-*/*/*.bb \
        ${LAYERDIR}/recipes-*/*/*.bbappend"

BBFILE_COLLECTIONS += "odroid-layer"
BBFILE_PATTERN_odroid-layer = "^${LAYERDIR}/"
BBFILE_PRIORITY_odroid-layer = "6"

LAYERDEPENDS_odroid-layer = "core"
```

## conf/machine/include/odroid-default-settings.inc
```bitbake
# Odroid BSP default settings

PREFERRED_PROVIDER_virtual/xserver ?= "xserver-xorg"
XSERVER ?= "xserver-xorg \
           xf86-input-evdev \
           xf86-input-mouse \
           xf86-video-fbdev \
           xf86-input-keyboard"

PREFERRED_PROVIDER_virtual/kernel ?= "linux-stable"
PREFERRED_VERSION_linux-stable ?= "4.14%"
LINUX_VERSION_EXTENSION ?= "-odroid"

KERNEL_IMAGETYPE ?= "zImage"

PREFERRED_PROVIDER_virtual/bootloader ?= "u-boot"
PREFERRED_PROVIDER_u-boot ?= "u-boot"
PREFERRED_VERSION_u-boot ?= "2017.09"

UBOOT_ENV  ?= "boot"
UBOOT_BINARY ?= "u-boot-dtb.bin"
UBOOT_ENV_SUFFIX ?= "scr"

MACHINE_FEATURES = "serial usbgadget usbhost vfat ext2 alsa screen"
MACHINE_EXTRA_RRECOMMENDS += " kernel-modules kernel-devicetree"

IMAGE_FSTYPES_append = " ext4 sdcard"
```

## conf/machine/include/odroid-xu-default.inc
```bitbake
# Odroid XU default BSP

include conf/machine/include/samsung-exynos.inc
include conf/machine/include/odroid-default-settings.inc

DEFAULTTUNE = "cortexa15hf-neon"
include conf/machine/include/tune-cortexa15.inc


UBOOT_FDT_LOADADDR ?= "0x40800000"
UBOOT_LOADADDR ?= "0x40007FC0"
UBOOT_CONSOLE ?= "console=ttySAC2,115200"
UBOOT_KENREL_NAME ?= "zimage"

IMAGE_ROOTFS_ALIGNMENT = "4096"

UBOOT_SCRIPT = "boot.scr"
```

## conf/machine/odroid-xu3.conf
```bitbake
#@TYPE: Machine
#@NAME: odroid-xu3
#@DESCRIPTION: Machine configuration for odroid-xu3 systems
#@MAINTAINER: Armin Kuster <akuster808@gmail.com>


include conf/machine/include/odroid-xu-default.inc

EXTRA_IMAGEDEPENDS += "u-boot secure-odroid-xu3"

UBOOT_B2_POS ?= "31"
UBOOT_BIN_POS ?= "63"
UBOOT_TZSW_POS ?= "2111"
UBOOT_ENV_POS ?= "2625"

KERNEL_DEVICETREE ?= "exynos5422-odroidxu3.dtb"
UBOOT_MACHINE_odroid-xu3 = "odroid-xu3_defconfig"
```

## conf/machine/odroid-xu4.conf
```bitbake
#@TYPE: Machine
#@NAME: odroid-xu4
#@DESCRIPTION: Machine configuration for odroid-xu4 systems
#@MAINTAINER: Alexandre Tuleu <alexandre.tuleu.2005@polytechnique.org>


include conf/machine/include/odroid-xu-default.inc


EXTRA_IMAGEDEPENDS += "u-boot secure-odroid-xu4"
#odroid-xu general
#https://wiki.odroid.com/odroid-xu4/software/partition_table#mainline_u-boot_odroidxu4-v201705
#Varies with uboot versioni
UBOOT_B1_POS ?= "1"
UBOOT_B2_POS ?= "31"
UBOOT_BIN_POS ?= "63"
UBOOT_TZSW_POS ?= "1503"
UBOOT_ENV_POS ?= "2015"

KERNEL_DEVICETREE ?= "exynos5422-odroidxu4.dtb"
UBOOT_MACHINE_odroid-xu4 = "odroid-xu4_defconfig"
```
